## non_HLOS/wm_proc/productsw/btsw/config/Kconfig
```kconfig
# ------------------------------------------------------------------------------
#  Copyright (c) Qualcomm Technologies, Inc.
#  All rights reserved.
#  Confidential and Proprietary - Qualcomm Technologies, Inc.
# ------------------------------------------------------------------------------

config LPAI_BTSW_ENABLE
    bool "Enable Bluetooth on AWM"
    default n
    help
        This enables bluetooth related functionality on M55.


config LPAI_BTSW_BTTEST_ENABLE
    bool "Enable BT Test Functionality"
    default n
    depends on SHELL
    help
        This enables the BT Test functionality and related source files

config LPAI_BT_TEST_MENU
    bool "Enable BT Test Menu on the Shell"
    default n
    depends on LPAI_BTSW_BTTEST_ENABLE
    help
        This enables the BT Test Menu on the Shell


config LPAI_BTSW_ENABLE_ISLAND_TEST
    bool "Enable Forced Island Entry/Exit"
    default n
    help
        This flag helps enablement of Dev Testing for Island on ADSP


choice LPAI_BTSW_GATT_OFFLOAD_MODE
    prompt "GATT Offload variant"
    optional
    help
      Select the offload variant to enable. You may also select none.

config LPAI_BTSW_ENABLE_GATT_OFFLOAD
    bool "GATT Offload Variant Using Legacy Headers and APIS"

config LPAI_BTSW_ENABLE_GATT_OFFLOAD_GHEADER
    bool "GATT Offload Variant Using Google Headers"
endchoice


	
config LPAI_BT_GATT_THROUGHPUT_MENU
    bool "Enable BT Test Throughput Menu"
    depends on LPAI_BTSW_ENABLE_GATT_OFFLOAD_GHEADER
    default n
    help
        This enables the BT Test Throughput Menu	

orsource "../*/config/Kconfig"
```

## non_HLOS/wm_proc/productsw/common/config/Kconfig
```kconfig
# ------------------------------------------------------------------------------
#  Copyright (c) Qualcomm Technologies, Inc.
#  All rights reserved.
#  Confidential and Proprietary - Qualcomm Technologies, Inc.
# ------------------------------------------------------------------------------

config PDTSW_COMMON_MODULES_ENABLE
    bool "Enable common modules"
    default n
    help
        Enables common modules for productsw services.

config PDTSW_COMMON_STATE_MACHINE_ENABLE
    bool "Enable pdtsw state machine framework"
    depends on PDTSW_COMMON_MODULES_ENABLE
    default n
    help
        Enables the state machine framework for productsw services.

config PDTSW_COMMON_UTILS_ENABLE
    bool "Enable pdtsw common utility module"
    depends on QC_SHELL_BACKEND_SERIAL
    default n
    help
        Enables productsw common utility module

config PDTSW_COMMON_UTILS_DBG_LOGGING
    bool "Enable logging for pdtsw common utility module"
    default n
    help
        Enables logging for productsw common utility module

config PDTSW_GLINK_STUB_ENABLE
    bool "Enable glink stubs"
    depends on PDTSW_COMMON_MODULES_ENABLE
    default n
    help
        This stubs the glink core to all the productsw components.

config PDTSW_COMMON_HEAP_MGR_ENABLE
    bool "Enable heap manager"
    depends on PDTSW_COMMON_MODULES_ENABLE
    default n
    help
        Enables heap manager for productsw services.

config PDTSW_COMMON_GLINK_HEAP_SIZE
    int "Product software glink heap size"
    depends on PDTSW_COMMON_HEAP_MGR_ENABLE
    range 1024 4096
    default 2048
    help
        This will be used by the product software components for glink transactions.

config PDTSW_COMMON_HEAP_SIZE
    int "Product software common heap size"
    depends on PDTSW_COMMON_HEAP_MGR_ENABLE
    range 1024 4096
    default 4096
    help
        This will be used by the product software components

config PDTSW_COMMON_WORKER_THREAD_ENABLE
    bool "Enable productsw default worker thread"
    depends on PDTSW_COMMON_MODULES_ENABLE
    default n
    help
        Enables default workerthread to use across productsw services

config PDTSW_DEFAULT_WORKQ_STACKSIZE
    int "Product software default workq stack size"
    range 1024 2048
    default 2048
    help
        This will be used by the default workqueue thread to allocate stack size
        Memory will be allocated from common heap memory pool.

config PDTSW_DEFAULT_WORKQ_THREAD_PRIORITY
    int "Product software default workq priority"
    depends on PDTSW_COMMON_WORKER_THREAD_ENABLE
    range 1 50
    default 21
    help
        This will be used by the default workqueue thread to allocate priority

config QC_PDTSW_GC_WORKQ_STACKSIZE
    int "Product software garbage collector workq stack size"
    range 768 2048
    default 1024
    help
        This will be used by the garbage collector workqueue thread to allocate stack size
        Memory will be allocated from common heap memory pool.

config QC_PDTSW_GC_WORKQ_THREAD_PRIORITY
    int "Product software garbage collector workq priority"
    range 1 50
    default 23
    help
        This will be used by the garbage collector workqueue thread to allocate priority
        The priority should be lower than all other product software threads
```

## non_HLOS/wm_proc/productsw/glinkshell/config/Kconfig
```kconfig
# ------------------------------------------------------------------------------
#  Copyright (c) Qualcomm Technologies, Inc.
#  All rights reserved.
#  Confidential and Proprietary - Qualcomm Technologies, Inc.
# ------------------------------------------------------------------------------
config GLINK_SHELL
	bool "Make use of a glink backend for a phantom shell"
	depends on SHELL
	help
		=== GLINK Backend for QCLI-like operation with AM55 as Master ===

config GLINK_SHELL_MSGQ_ELEM_COUNT
	depends on GLINK_SHELL
	int "Number of elements within message queue"
	default 200
	help
		=== GLINK msgq element count ===

config GLINK_SHELL_PROMPT
	depends on GLINK_SHELL
	string "PROMPT FOR THE GLINK SHELL: ----CAN'T BE EMPTYSTR!!!----"
	default ">"
	help
		=== PROMPT FOR THE GLINK SHELL ----CAN'T BE EMPTYSTR!!!----  ===

config GLINK_SHELL_PASSTHROUGH
	depends on GLINK_SHELL
	bool "Enable the q6/wm passthroughs"
	help
		=== ENABLE the q6/wm passthrough ===

config GLINK_SHELL_THREAD_PRIORITY
	depends on GLINK_SHELL
	int "Priority to bring up glink thread"
	default 20
	help
		=== Priority level for glink thread ===

config GLINK_SHELL_THREAD_STACK_SZ
	depends on GLINK_SHELL
	int "Stack size alloted to glink thread"
	default 2048
	help
		=== Glink thread stack size ===

config GLINK_SHELL_LOG_LEVEL
	depends on GLINK_SHELL
	int "Log level for glink shell log level"
	default 2
	help
		=== glinkshell log level ===

config GLINK_SHELL_TRANSPORT_BUF_SZ
	depends on GLINK_SHELL
	int "Size of glink transport for WM shell"
	default 256
	help
		=== glinkshell TX/RX buf size ===
```

## non_HLOS/wm_proc/productsw/offload_mgr/config/Kconfig
```kconfig
# ------------------------------------------------------------------------------
#  Copyright (c) Qualcomm Technologies, Inc.
#  All rights reserved.
#  Confidential and Proprietary - Qualcomm Technologies, Inc.
# ------------------------------------------------------------------------------

config PDTSW_OFFLOAD_MGR_ENABLE
    bool "Enable offload manager"
    default n
    help
        This enables battery service functionality on M55 for the M55 clients to use in ambient mode.

config PDTSW_OFFLOAD_MGR_RSB_ENABLE
    bool "Enable RSB service offload support in offload manager"
    depends on PDTSW_OFFLOAD_MGR_ENABLE && PDTSW_RSB_SERVICE_ENABLE
    default n
    help
        Enable RSB service offload support in offload manager.

config PDTSW_OFFLOAD_MGR_AUDIO_ENABLE
    bool "Enable audio service offload support in offload manager"
    depends on PDTSW_OFFLOAD_MGR_ENABLE && PDTSW_AUDIO_SERVICE_ENABLE
    default n
    help
        Enable audio service offload support in offload manager.

config PDTSW_OFFLOAD_MGR_HAPTICS_ENABLE
    bool "Enable haptics service offload support in offload manager"
    depends on PDTSW_OFFLOAD_MGR_ENABLE && PDTSW_HAPTICS_SERVICE_ENABLE
    default n
    help
        Enable haptics service offload support in offload manager.

config PDTSW_OFFLOAD_MGR_HEAP_SIZE
    int "Offload manager heap size"
    range 64 4096
    default 64
    help
        This will be used by the audio service internally

config QC_PDTSW_OFFLOAD_MGR_THREAD_PRIORITY
    int "Offload Manager Workq Thread Priority"
    default 21
    help
        Priority for the offload manager workq thread

config QC_PDTSW_OFFLOAD_MGR_THREAD_STACK_SIZE
    int "Offload Manager Workq Thread Stack Size"
    default 2048
    help
        Stack size in bytes for the offload manager workq thread
```

## non_HLOS/wm_proc/productsw/qsh_glink_router/config/Kconfig
```kconfig
# ------------------------------------------------------------------------------
#  Copyright (c) Qualcomm Technologies, Inc.
#  All rights reserved.
#  Confidential and Proprietary - Qualcomm Technologies, Inc.
# ------------------------------------------------------------------------------

config PDTSW_QSH_GLINK_ROUTER_ENABLE
    bool "Enable QSH Glink router"
    default n
    depends on NANOPB
    help
        This enables QSH Glink router functionality on M55 to talk to remote QSH over Glink.

config PDTSW_QSH_GLINK_ROUTER_MAX_STATUS_CLIENTS
    int "Number of status clients supported by QSH Glink router"
    range 2 10
    default 4
    help
        Maximum number of clients supported by QSH Glink router.

config PDTSW_QSH_GLINK_ROUTER_MAX_CLIENTS
    int "Number of clients supported by QSH Glink router"
    range 2 10
    default 3
    help
        Maximum number of clients supported by QSH Glink router.

config PDTSW_QSH_GLINK_ROUTER_HEAP_SIZE
    int "Heap size on m55 TCM"
    range 1024 4096
    default 1024
    help
        This will be used by the QSH router

config PDTSW_QSH_GLINK_ROUTER_PROFILING
    bool "Enable QSH Glink router profiling"
    depends on PDTSW_QSH_GLINK_ROUTER_ENABLE
    default n
    help
        Enable additional APIs to profile QSH Glink router API latencies
```
